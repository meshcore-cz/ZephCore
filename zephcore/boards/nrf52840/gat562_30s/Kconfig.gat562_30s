## zephcore/boards/nrf52840/gat562_30s/Kconfig.gat562_30s
```kconfig
# GAT562 30S Mesh Kit board selection
# SPDX-License-Identifier: Apache-2.0

config BOARD_GAT562_30S
	select SOC_NRF52840_QIAA
	select ZEPHCORE_UI_JOYSTICK	# 5-way joystick -> full companion menu UI
```
